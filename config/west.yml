## config/west.yml
```yaml
manifest:
  remotes:
    - name: zmkfirmware
      url-base: https://github.com/zmkfirmware
    - name: 280Zo
      url-base: https://github.com/280Zo
    - name: KOHSUK
      url-base: https://github.com/KOHSUK

  projects:
    - name: zmk
      remote: zmkfirmware
      revision: main
      import: app/west.yml
    - name: zmk-pmw3360-driver
      remote: KOHSUK
      revision: pmw3360
    - name: prospector-zmk-module
      remote: 280Zo
      revision: main

  self:
    path: config
```
